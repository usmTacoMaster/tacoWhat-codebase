// ESP32 6-wheel rover (skid steering) + ultrasonic stop
// Join the "Rover-Planet" Wi-Fi, then open http://192.168.4.1
//
// This version contains the NEW page (camera above the controls, docked / mini view, photo button).
// Nothing to paste: open it, pick your ESP32 board, upload.

#include <WiFi.h>
#include <WebServer.h>
#include <stddef.h>
#include <stdint.h>
#ifndef PROGMEM
#define PROGMEM
#endif


// ---------- Settings ----------
const char* AP_NAME = "Rover-Planet";
const char* AP_PASS = "rover1234";        // 8+ characters

// L298N motor driver pins
const int ENA = 25, IN1 = 26, IN2 = 27;   // LEFT side (3 motors)
const int ENB = 33, IN3 = 32, IN4 = 19;   // RIGHT side (3 motors)

// Ultrasonic sensor (HC-SR04)
const int TRIG_PIN = 5;
const int ECHO_PIN = 18;                  // must go through a voltage divider

const int STOP_CM = 20;                   // no forward driving closer than this
const int MIN_DUTY = 90;                  // weakest push that still moves the motors (0-255)
const unsigned long FAILSAFE_MS = 500;    // no command for this long = stop
const int PWM_FREQ = 2000;


// ====================================================================
// The control page (compressed). Generated from the new index.html.
// raw: 48808 bytes, gzip: 12969 bytes
const uint8_t INDEX_HTML_GZ[] PROGMEM = {
  0x1f, 0x8b, 0x08, 0x00, 0x00, 0x00, 0x00, 0x00, 0x02, 0x03, 0xe5, 0x7d,
  0x6b, 0x77, 0xdb, 0x46, 0x92, 0xe8, 0x77, 0xff, 0x8a, 0x36, 0x72, 0x66,
  0x86, 0x8c, 0x49, 0x88, 0x84, 0x28, 0x59, 0x22, 0x2d, 0x65, 0x6d, 0x59,
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  0x01, 0x7f, 0x18, 0x45, 0xd0, 0xa8, 0xbe, 0x00, 0x00,
};
const size_t INDEX_HTML_GZ_LEN = 12969;
// ====================================================================


// Works on both old and new ESP32 Arduino versions
#if ESP_ARDUINO_VERSION_MAJOR >= 3
  #define PWM_ATTACH(pin, ch) ledcAttach(pin, PWM_FREQ, 8)
  #define PWM_WRITE(pin, ch, duty) ledcWrite(pin, duty)
#else
  #define PWM_ATTACH(pin, ch) do { ledcSetup(ch, PWM_FREQ, 8); ledcAttachPin(pin, ch); } while (0)
  #define PWM_WRITE(pin, ch, duty) ledcWrite(ch, duty)
#endif

WebServer server(80);

int targetX = 0, targetY = 0;             // x = turn, y = forward (-100..100)
unsigned long lastCmd = 0, lastPing = 0;
int distanceCm = -1;                      // -1 = nothing detected
int leftNow = 0, rightNow = 0;
bool blocked = false;

const char PAGE[] PROGMEM = R"rawliteral(
<!DOCTYPE html>
<html>
<head>
<meta name="viewport" content="width=device-width, initial-scale=1, user-scalable=no">
<title>Rover</title>
<style>
  * { box-sizing:border-box; -webkit-user-select:none; user-select:none; -webkit-touch-callout:none; }
  body { background:#0b1220; color:#e6edf3; font-family:sans-serif; margin:0; padding:16px; text-align:center; }
  #dist { font-size:20px; margin:8px 0 18px; }
  .pad { display:grid; grid-template-columns:repeat(3,92px); grid-template-rows:repeat(3,92px); gap:10px; justify-content:center; }
  button { font-size:34px; border:0; border-radius:16px; background:#1c2a3f; color:#e6edf3; touch-action:none; }
  button:active { background:#2f6fed; }
  #stop { background:#7a1f1f; }
  input { width:80%; margin-top:10px; }
</style>
</head>
<body>
  <h2>Rover</h2>
  <div id="dist">Distance: --</div>
  <div class="pad">
    <span></span><button data-d="f">&#9650;</button><span></span>
    <button data-d="l">&#9664;</button><button id="stop">&#9632;</button><button data-d="r">&#9654;</button>
    <span></span><button data-d="b">&#9660;</button><span></span>
  </div>
  <div style="margin-top:24px">Speed: <b id="sv">70</b>%</div>
  <input type="range" min="30" max="100" value="70" id="spd">
<script>
let spd = 70, timer = null;
const dirs = { f:[0,1], b:[0,-1], l:[-1,0], r:[1,0] };
const send = (x, y) => fetch('/drive?x=' + x + '&y=' + y).catch(() => {});

function press(d) {
  if (timer) clearInterval(timer);
  const [dx, dy] = dirs[d];
  send(dx * spd, dy * spd);
  timer = setInterval(() => send(dx * spd, dy * spd), 100);
}
function release() {
  if (timer) { clearInterval(timer); timer = null; fetch('/stop').catch(() => {}); }
}
document.querySelectorAll('[data-d]').forEach(b => {
  b.addEventListener('pointerdown', e => { e.preventDefault(); press(b.dataset.d); });
  ['pointerup', 'pointerleave', 'pointercancel'].forEach(ev => b.addEventListener(ev, release));
});
document.getElementById('stop').onclick = () => {
  clearInterval(timer); timer = null; fetch('/stop').catch(() => {});
};
document.getElementById('spd').oninput = e => {
  spd = +e.target.value;
  document.getElementById('sv').textContent = spd;
};
setInterval(async () => {
  try {
    const s = await (await fetch('/status')).json();
    const d = document.getElementById('dist');
    d.textContent = 'Distance: ' + (s.distance < 0 ? 'clear' : s.distance + ' cm');
    d.style.color = s.blocked ? '#f85149' : '#e6edf3';
  } catch (e) {}
}, 500);
</script>
</body>
</html>
)rawliteral";

// ---------- Motors ----------
void setMotor(int in1, int in2, int en, int ch, int speed) {   // speed -100..100
  digitalWrite(in1, speed > 0 ? HIGH : LOW);
  digitalWrite(in2, speed < 0 ? HIGH : LOW);
  int duty = 0;
  if (speed != 0) duty = map(abs(speed), 1, 100, MIN_DUTY, 255);
  PWM_WRITE(en, ch, duty);
}

void updateDrive() {
  int x = targetX, y = targetY;

  if (millis() - lastCmd > FAILSAFE_MS) { x = 0; y = 0; }    // lost contact: stop

  blocked = (distanceCm > 0 && distanceCm < STOP_CM);
  if (blocked && y > 0) y = 0;           // no driving into a wall; turning/reversing still work

  // Skid steering: left and right sides get different speeds
  int l = y + x;
  int r = y - x;
  int m = max(abs(l), abs(r));
  if (m > 100) { l = l * 100 / m; r = r * 100 / m; }

  leftNow = l;
  rightNow = r;
  setMotor(IN1, IN2, ENA, 0, l);
  setMotor(IN3, IN4, ENB, 1, r);
}

// ---------- Ultrasonic ----------
int readDistanceCm() {
  digitalWrite(TRIG_PIN, LOW);  delayMicroseconds(2);
  digitalWrite(TRIG_PIN, HIGH); delayMicroseconds(10);
  digitalWrite(TRIG_PIN, LOW);
  long us = pulseIn(ECHO_PIN, HIGH, 20000);    // gives up after 20 ms (about 3 m)
  if (us == 0) return -1;
  return us / 58;
}

// ---------- Web handlers ----------
void sendText(int code, const char* type, const String& body) {
  server.sendHeader("Access-Control-Allow-Origin", "*");   // lets other apps call us too
  server.send(code, type, body);
}

void handleSimple() {
  server.send_P(200, "text/html", PAGE);
}

void handleRoot() {              // the Tacover-style page
  server.sendHeader("Content-Encoding", "gzip");
  server.sendHeader("Cache-Control", "no-cache");
  server.send_P(200, "text/html", (const char*)INDEX_HTML_GZ, INDEX_HTML_GZ_LEN);
}

void handleDrive() {
  targetX = constrain(server.arg("x").toInt(), -100, 100);
  targetY = constrain(server.arg("y").toInt(), -100, 100);
  lastCmd = millis();
  sendText(200, "text/plain", "ok");
}

void handleStop() {
  targetX = 0;
  targetY = 0;
  lastCmd = millis();
  sendText(200, "text/plain", "ok");
}

void handleStatus() {
  String j = "{\"distance\":" + String(distanceCm) +
             ",\"blocked\":" + (blocked ? "true" : "false") +
             ",\"left\":" + String(leftNow) +
             ",\"right\":" + String(rightNow) +
             ",\"phones\":" + String(WiFi.softAPgetStationNum()) + "}";
  sendText(200, "application/json", j);
}

// ---------- Main ----------
void setup() {
  Serial.begin(115200);

  pinMode(IN1, OUTPUT); pinMode(IN2, OUTPUT);
  pinMode(IN3, OUTPUT); pinMode(IN4, OUTPUT);
  PWM_ATTACH(ENA, 0);
  PWM_ATTACH(ENB, 1);
  setMotor(IN1, IN2, ENA, 0, 0);
  setMotor(IN3, IN4, ENB, 1, 0);

  pinMode(TRIG_PIN, OUTPUT);
  pinMode(ECHO_PIN, INPUT);

  WiFi.mode(WIFI_AP);
  WiFi.softAP(AP_NAME, AP_PASS, 1, 0, 4);      // channel 1, visible, up to 4 phones
  Serial.print("Rover Wi-Fi ready. Open http://");
  Serial.println(WiFi.softAPIP());

  server.on("/simple", handleSimple);
  server.on("/favicon.ico", []() { server.send(204); });   // phones ask for this icon; answer quickly
  server.on("/", handleRoot);
  server.on("/drive", handleDrive);
  server.on("/stop", handleStop);
  server.on("/status", handleStatus);
  server.begin();
}

void loop() {
  server.handleClient();

  if (millis() - lastPing > 80) {              // check distance about 12 times a second
    distanceCm = readDistanceCm();
    lastPing = millis();
  }

  updateDrive();
}